## boards/arm/sim_wheel_nrf52840/Kconfig.defconfig
```kconfig
# Adafruit Feather nRF52840 Express board configuration

# Copyright (c) 2020 Tobias Svehagen
# SPDX-License-Identifier: Apache-2.0

if BOARD_SIM_WHEEL_NRF52840

config BOARD
	default "sim_wheel_nrf52840"

config BT_CTLR
	default BT

endif # BOARD_SIM_WHEEL_NRF52840
```
